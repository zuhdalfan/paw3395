## drivers/paw3395/Kconfig
```kconfig
# <module>/drivers/paw3395/Kconfig
config PAW3395
    bool "PixArt PAW3395 Optical Sensor"
    default n
    depends on SPI
    help
      Enable support for the PixArt BUTTON123 optical sensor.

config PAW3395_INIT_PRIORITY
    int "Init priority for PAW3395"
    default 70
```
